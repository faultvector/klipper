## src/mcx/Kconfig
```kconfig
# Kconfig settings for NXP MCX processors

if MACH_MCX

config MCX_SELECT
    bool
    default y
    select HAVE_GPIO
    select HAVE_GPIO_ADC
    select HAVE_GPIO_SPI

config BOARD_DIRECTORY
    string
    default "mcx"

choice
    prompt "Processor model"

config MACH_MCXA366
    bool "MCXA366"

endchoice

######################################################################
# Communication interface
######################################################################

choice
    prompt "Communication Interface"

config MCX_SERIAL
    bool "UART"
    select SERIAL

config MCX_CANBUS
    bool "CAN bus"
    select CANSERIAL

endchoice

config MCU
    string
    default "mcxa366" if MACH_MCXA366

config CLOCK_FREQ
    int
    default 240000000

config FLASH_SIZE
    hex
    default 0xFE000

config FLASH_BOOT_ADDRESS
    hex
    default 0x00000000

config FLASH_APPLICATION_ADDRESS
    hex
    default 0x00000000

config RAM_START
    hex
    default 0x20000000

config RAM_SIZE
    hex
    default 0x3C000

config STACK_SIZE
    int
    default 2048

# These sensor drivers require an I2C configuration type even when used
# over SPI. I2C support has not been implemented for MCXA366 yet.
config WANT_LIS2DW
    default n

config WANT_BMI160
    default n

config WANT_MPU9250
    default n

config WANT_ICM20948
    default n

endif
```
